VERSION ""

NS_ :

BS_ :

BU_ :

BO_ 2147484548 OFS_FTIR_0: 64 Vector__XXX
  SG_ Pressure_Gascell : 0|32@1+ (0.10000000149011611938,0) [0|1000] "" Vector__XXX
  SG_ Temp__HL_1_ : 32|32@1+ (0.10000000149011611938,0) [0|1000] "°C" Vector__XXX

BO_ 2147484549 OFS_FTIR_1: 64 Vector__XXX
  SG_ Temp__Gehaeuse_1_ : 32|32@1+ (0.10000000149011611938,0) [0|1000] "°C" Vector__XXX
  SG_ Temp__HL_2_ : 0|32@1+ (0.10000000149011611938,0) [0|1000] "°C" Vector__XXX

BO_ 2147484550 OFS_FTIR_2: 64 Vector__XXX
  SG_ WOBDNumber_of_warm_ups_since_DTCs_cleared_ : 32|32@1+ (0.10000000149011611938,0) [0|1000] "" Vector__XXX
  SG_ WOBDTime_Since_Engine_Start_ : 0|32@1+ (0.10000000149011611938,0) [0|1000] "s" Vector__XXX

BO_ 2147484551 OFS_FTIR_3: 64 Vector__XXX
  SG_ WOBDBarometric_Pressure_ : 0|32@1+ (0.10000000149011611938,0) [0|1000] "kPa" Vector__XXX

BO_ 2147484648 OFS_Status_0: 64 Vector__XXX
  SG_ Konstant_0 : 0|32@1+ (0.10000000149011611938,0) [0|1000] "" Vector__XXX

BA_DEF_ "DBName" STRING;
BA_DEF_ "BusType" STRING;
BA_DEF_ BO_ "VFrameFormat" ENUM "StandardCAN","ExtendedCAN","reserved","J1939PG","reserved","reserved","reserved","reserved","reserved","reserved","reserved","reserved","reserved","reserved","StandardCAN_FD","ExtendedCAN_FD";
BA_DEF_ BO_ "GenMsgSendType" ENUM "Cyclic","Event","CyclicIfActive","SpontanWithDelay","CyclicAndSpontan","CyclicAndSpontanWithDelay";
BA_DEF_DEF_ "DBName" "OFS_Cluster";
BA_DEF_DEF_ "BusType" "CAN";
BA_DEF_DEF_ "VFrameFormat" "StandardCAN";
BA_DEF_DEF_ "GenMsgSendType" "Cyclic";
BA_ "VFrameFormat" BO_ 2147484548 1;
BA_ "VFrameFormat" BO_ 2147484549 1;
BA_ "VFrameFormat" BO_ 2147484550 1;
BA_ "VFrameFormat" BO_ 2147484551 1;
BA_ "VFrameFormat" BO_ 2147484648 1;
